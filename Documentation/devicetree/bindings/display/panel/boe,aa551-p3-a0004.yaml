## Documentation/devicetree/bindings/display/panel/boe,aa551-p3-a0004.yaml
```yaml
# SPDX-License-Identifier: (GPL-2.0-only OR BSD-2-Clause)
%YAML 1.2
---
$id: http://devicetree.org/schemas/display/panel/boe,aa551-p3-a0004.yaml#
$schema: http://devicetree.org/meta-schemas/core.yaml#

title: BOE AA551 P3 A0004 AMOLED DSI Panel

maintainers:
  - inferno0230 <mail@inferno0230.in>

description:
  The AA551 P3 A0004 is a 1264x2780 command-mode AMOLED panel. It uses a
  four-lane MIPI DSI interface and Display Stream Compression.

allOf:
  - $ref: panel-common.yaml#

properties:
  compatible:
    const: boe,aa551-p3-a0004

  reg:
    maxItems: 1
    description: DSI virtual channel

  vci-supply:
    description: Panel analog supply

  vddio-supply:
    description: Panel I/O supply

  enable-gpios:
    maxItems: 1
    description: Panel VOUT enable

  port: true
  reset-gpios: true

required:
  - compatible
  - enable-gpios
  - reg
  - reset-gpios
  - vci-supply
  - vddio-supply
  - port

additionalProperties: false

examples:
  - |
    #include <dt-bindings/gpio/gpio.h>

    dsi {
        #address-cells = <1>;
        #size-cells = <0>;

        panel@0 {
            compatible = "boe,aa551-p3-a0004";
            reg = <0>;

            enable-gpios = <&tlmm 90 GPIO_ACTIVE_HIGH>;
            reset-gpios = <&tlmm 133 GPIO_ACTIVE_LOW>;

            vci-supply = <&vreg_l13b_3p0>;
            vddio-supply = <&vreg_l12b_1p8>;

            port {
                panel_in: endpoint {
                    remote-endpoint = <&dsi0_out>;
                };
            };
        };
    };
...
```
